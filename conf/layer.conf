## conf/layer.conf
```bitbake
# We have a conf and classes directory, add to BBPATH
BBPATH .= ":${LAYERDIR}"

# We have recipes-* directories, add to BBFILES
BBFILES += "${LAYERDIR}/recipes-*/*/*.bb \
            ${LAYERDIR}/recipes-*/*/*.bbappend"

BBFILE_COLLECTIONS += "meta-fleet-monitoring-poc"
BBFILE_PATTERN_meta-fleet-monitoring-poc = "^${LAYERDIR}/"
BBFILE_PRIORITY_meta-fleet-monitoring-poc = "90"

LAYERDEPENDS_meta-fleet-monitoring-poc = "core"
LAYERSERIES_COMPAT_meta-fleet-monitoring-poc = "dunfell"
```
